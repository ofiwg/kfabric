## Kconfig
```kconfig
config KOFI
	tristate "Kernel Open Fabric Interface"
	default y
	---help---
	  Support for the Open Fabric Interface.

	  See <https://www.openfabrics.org/downloads/ofiwg/>

config KOFI_VERBS
	bool "Verbs Provider Kernel Open Fabric Interface"
	depends on KOFI
	default y
	---help---
	  This option enables support for the verbs provider for
	  the Open Fabric Interface.
```
